// spo2_model.h
// ------------
// Single-file C++ inference engine for RawCrossAttentionSpO2Net.
// No external dependencies beyond <math.h> and <string.h>.
//
// Targets: nRF52840 (Cortex-M4 + FPU) via Arduino / Zephyr.
// Also compiles on x86 for desktop validation.
//
// Usage:
//   #include "spo2_model.h"
//   #include "weights/meta.h"       // generated by export_weights.py
//   #include "weights_flash.h"      // generated by gen_weight_headers.py
//
//   float red[400], ir[400];        // normalised PPG windows
//   float spo2 = spo2_infer(red, ir, skintone);
//
// Memory budget (static buffers, all in .bss / stack):
//   Encoder tokens  : 2 × [398 × 64] fp32 = 203 KB  <-- largest allocation
//   Attention chunks: chunked, never full [T×T]
//   See CHUNKED_ATTN_SIZE below.
//
// !! IMPORTANT: with T=400, D=64 the two encoder output buffers alone
//    consume ~200 KB.  You MUST reduce MODEL_SEQ_LEN (window_size) to <=50
//    OR use QSPI-backed buffers.  The chunked attention itself is fine;
//    the encoder tokens are the binding constraint.
//    Recommended: retrain with window_size=50 → encoder tokens = 2×[48×64]
//    = 24 KB total.  Everything else is commentary.

#pragma once
#ifdef __cplusplus
extern "C" {
#endif

#include <stdint.h>
#include <math.h>
#include <string.h>

// ── Tuneable constants ────────────────────────────────────────────────────────
#ifndef MODEL_SEQ_LEN
#  define MODEL_SEQ_LEN   400      // change to 50 if retraining
#endif
#ifndef MODEL_HIDDEN_DIM
#  define MODEL_HIDDEN_DIM  64
#endif
#ifndef MODEL_HIDDEN_DIM2
#  define MODEL_HIDDEN_DIM2 128    // 2 × HIDDEN_DIM
#endif
#ifndef MODEL_NUM_HEADS
#  define MODEL_NUM_HEADS   4
#endif
#ifndef MODEL_HEAD_DIM
#  define MODEL_HEAD_DIM   16      // HIDDEN_DIM / NUM_HEADS
#endif
#ifndef MODEL_HEAD_DIM2
#  define MODEL_HEAD_DIM2  32      // HIDDEN_DIM2 / NUM_HEADS
#endif

// Chunked attention: process this many query rows at a time.
// Memory for one chunk = CHUNK × T × sizeof(float) = 8 × 400 × 4 = 12.8 KB
// Reduce if RAM is tight.
#ifndef CHUNKED_ATTN_SIZE
#  define CHUNKED_ATTN_SIZE  8
#endif

// Conv output length: first Conv1d(k=5, pad=1) loses 2 samples; rest keep T.
#define CONV_OUT_LEN  (MODEL_SEQ_LEN - 2)

// ── Primitive: ReLU ───────────────────────────────────────────────────────────
static inline float relu(float x) { return x > 0.0f ? x : 0.0f; }
static inline float tanhf_approx(float x) { return tanhf(x); }  // FPU handles this

// ── Softmax in-place over length n ───────────────────────────────────────────
static void softmax_inplace(float* x, int n) {
    float mx = x[0];
    for (int i = 1; i < n; i++) if (x[i] > mx) mx = x[i];
    float s = 0.0f;
    for (int i = 0; i < n; i++) { x[i] = expf(x[i] - mx); s += x[i]; }
    for (int i = 0; i < n; i++) x[i] /= s;
}

// ── LayerNorm: out[i] = (x[i] - mean) / sqrt(var+eps) * w[i] + b[i] ─────────
static void layer_norm(const float* x, const float* w, const float* b,
                        float* out, int D) {
    float mean = 0.0f, var = 0.0f;
    for (int i = 0; i < D; i++) mean += x[i];
    mean /= D;
    for (int i = 0; i < D; i++) { float d = x[i] - mean; var += d*d; }
    var = var / D + 1e-5f;
    float inv_std = 1.0f / sqrtf(var);
    for (int i = 0; i < D; i++) out[i] = (x[i] - mean) * inv_std * w[i] + b[i];
}

// ── Linear: out[M] = W[M×N] @ x[N] + b[M]  (INT8 weights, FP32 bias) ────────
// scale: the per-tensor INT8 scale for W
static void linear_i8(const int8_t* W, const float* b, float scale,
                       const float* x, float* out, int M, int N) {
    for (int m = 0; m < M; m++) {
        float acc = 0.0f;
        const int8_t* row = W + m * N;
        for (int n = 0; n < N; n++) acc += (float)row[n] * x[n];
        out[m] = acc * scale + b[m];
    }
}

// ── Conv1d (single sample, no batch dim) ─────────────────────────────────────
// x    : [C_in × T_in]   (C_in rows, each length T_in)
// W    : [C_out × C_in × K]  INT8
// b    : [C_out]          FP32
// out  : [C_out × T_out]
// padding is applied symmetrically before calling (caller pads or we handle here)
static void conv1d_i8(
        const float* x,      // [C_in, T_in]
        int C_in, int T_in,
        const int8_t* W,     // [C_out, C_in, K]
        const float*  b,     // [C_out]
        float scale,
        int C_out, int K, int pad,
        float* out,          // [C_out, T_out]
        int T_out)
{
    for (int co = 0; co < C_out; co++) {
        for (int t = 0; t < T_out; t++) {
            float acc = 0.0f;
            for (int ci = 0; ci < C_in; ci++) {
                for (int k = 0; k < K; k++) {
                    int src = t + k - pad;
                    if (src < 0 || src >= T_in) continue;
                    float xval = x[ci * T_in + src];
                    int8_t wval = W[(co * C_in + ci) * K + k];
                    acc += xval * (float)wval;
                }
            }
            out[co * T_out + t] = acc * scale + b[co];
        }
    }
}

// ── ReLU over a flat buffer ───────────────────────────────────────────────────
static void relu_buf(float* x, int n) {
    for (int i = 0; i < n; i++) x[i] = relu(x[i]);
}

// ── Conv encoder: 3 Conv-BN-ReLU blocks (BN fused into conv weights) ─────────
// Input  x: [1, T]  (single channel, T samples)
// Output o: [T_out, D]  (transposed: tokens first)
//
// Scratch buffers must be pre-allocated by caller; sizes:
//   tmp_a: [32, T]   (after block1)
//   tmp_b: [D, T]    (after block2 / block3)
//   (T = MODEL_SEQ_LEN, T_out = CONV_OUT_LEN)
static void conv_encoder(
        const float* x,           // [1, T]
        int T,
        // block 1: Conv(1->32, k=5, pad=1) -> T_out = T-2
        const int8_t* W0, const float* b0, float s0,
        // block 2: Conv(32->D, k=3, pad=1) -> same T_out
        const int8_t* W1, const float* b1, float s1,
        // block 3: Conv(D->D, k=3, pad=1) -> same T_out
        const int8_t* W2, const float* b2, float s2,
        int D,
        float* tmp_a,             // scratch [32 × T]    (caller alloc)
        float* tmp_b,             // scratch [D  × T]    (caller alloc)
        float* out)               // output  [T_out × D] (caller alloc)
{
    int T_out = T - 2;  // k=5 pad=1 loses 2

    // Block 1: Conv(1->32, k=5, pad=1)
    conv1d_i8(x, 1, T, W0, b0, s0, 32, 5, 1, tmp_a, T_out);
    relu_buf(tmp_a, 32 * T_out);

    // Block 2: Conv(32->D, k=3, pad=1)
    conv1d_i8(tmp_a, 32, T_out, W1, b1, s1, D, 3, 1, tmp_b, T_out);
    relu_buf(tmp_b, D * T_out);

    // Block 3: Conv(D->D, k=3, pad=1)
    // Reuse tmp_a as second D buffer (D=64 > 32, but T_out same — ensure tmp_a >= D*T_out)
    conv1d_i8(tmp_b, D, T_out, W2, b2, s2, D, 3, 1, tmp_a, T_out);
    relu_buf(tmp_a, D * T_out);

    // Transpose [D, T_out] -> [T_out, D]
    for (int t = 0; t < T_out; t++)
        for (int d = 0; d < D; d++)
            out[t * D + d] = tmp_a[d * T_out + t];
}

// ── SkinFiLM: scalar -> gamma_r[D], beta_r[D] ────────────────────────────────
// (gamma_i, beta_i produced but unused per your model's forward())
static void skin_film(
        float skintone,
        const int8_t* W0, const float* b0, float s0,   // fc0: [32, 1]
        const int8_t* W1, const float* b1, float s1,   // fc1: [4D, 32]
        int D,
        float* gamma_r, float* beta_r)                  // each [D]
{
    float h[32];
    // fc0: [32,1] @ [1] + b -> [32]
    for (int i = 0; i < 32; i++) {
        h[i] = (float)W0[i] * skintone * s0 + b0[i];
        h[i] = relu(h[i]);
    }
    // fc1: [4D, 32] -> [4D]
    // We only need the first 2D outputs (gamma_r, beta_r); skip gamma_i, beta_i
    float params[4 * 64];  // 4D, D<=64
    linear_i8(W1, b1, s1, h, params, 4 * D, 32);

    memcpy(gamma_r, params,       D * sizeof(float));
    memcpy(beta_r,  params + D,   D * sizeof(float));
}

// ── FiLM modulation: tokens[T, D] *= (1 + gamma[D]) + beta[D] ────────────────
static void film_modulate(float* tokens, int T, int D,
                           const float* gamma, const float* beta) {
    for (int t = 0; t < T; t++)
        for (int d = 0; d < D; d++)
            tokens[t * D + d] = tokens[t * D + d] * (1.0f + gamma[d]) + beta[d];
}

// ── Chunked Multi-Head Attention ──────────────────────────────────────────────
// Computes standard MHA with the [T×T] score matrix never fully materialised.
// Instead we process CHUNKED_ATTN_SIZE query rows at a time.
//
// q_in, k_in, v_in : [T, D_model]   (may be same pointer for self-attention)
// out              : [T, D_model]
//
// All projection weights are INT8; biases, LN weights are FP32.
// head_dim = D_model / num_heads
//
// Scratch (caller-provided):
//   proj_q, proj_k, proj_v : each [T × D_model]  fp32
//   scores_chunk            : [CHUNK × T]          fp32
//   v_chunk                 : [T × head_dim]       fp32  (one head at a time)
//   attn_out                : [T × D_model]        fp32
//   tmp_D                   : [D_model]             fp32  (for output proj per row)
static void chunked_mha(
        const float* q_in,       // [T, D]
        const float* k_in,       // [T, D]  (== q_in for self-attn)
        const float* v_in,       // [T, D]  (== q_in for self-attn)
        int T, int D, int num_heads,
        // in-proj weights (INT8) — each [D, D]
        const int8_t* Wq, const float* bq, float sq,
        const int8_t* Wk, const float* bk, float sk,
        const int8_t* Wv, const float* bv, float sv,
        // out-proj weight (INT8) [D, D]
        const int8_t* Wo, const float* bo, float so,
        // scratch (caller must provide)
        float* proj_q,           // [T × D]
        float* proj_k,           // [T × D]
        float* proj_v,           // [T × D]
        float* scores_chunk,     // [CHUNK × T]
        float* attn_out,         // [T × D]
        float* tmp_D)            // [D]
{
    int head_dim = D / num_heads;
    float scale  = 1.0f / sqrtf((float)head_dim);

    // Project Q, K, V for all tokens
    for (int t = 0; t < T; t++) {
        linear_i8(Wq, bq, sq, q_in + t*D, proj_q + t*D, D, D);
        linear_i8(Wk, bk, sk, k_in + t*D, proj_k + t*D, D, D);
        linear_i8(Wv, bv, sv, v_in + t*D, proj_v + t*D, D, D);
    }

    // Clear output
    memset(attn_out, 0, T * D * sizeof(float));

    // For each head
    for (int h = 0; h < num_heads; h++) {
        int offset = h * head_dim;

        // Process Q in chunks of CHUNKED_ATTN_SIZE rows
        for (int q_start = 0; q_start < T; q_start += CHUNKED_ATTN_SIZE) {
            int q_end  = q_start + CHUNKED_ATTN_SIZE;
            if (q_end > T) q_end = T;
            int chunk  = q_end - q_start;

            // Compute scores[chunk, T] = Q_chunk @ K^T / sqrt(head_dim)
            for (int qi = 0; qi < chunk; qi++) {
                const float* q_row = proj_q + (q_start + qi) * D + offset;
                for (int ki = 0; ki < T; ki++) {
                    const float* k_row = proj_k + ki * D + offset;
                    float dot = 0.0f;
                    for (int d = 0; d < head_dim; d++) dot += q_row[d] * k_row[d];
                    scores_chunk[qi * T + ki] = dot * scale;
                }
                // softmax over K dimension for this query row
                softmax_inplace(scores_chunk + qi * T, T);
            }

            // Accumulate: attn_out[q_start:q_end, offset:offset+head_dim]
            //           += scores_chunk @ V[:, offset:offset+head_dim]
            for (int qi = 0; qi < chunk; qi++) {
                float* out_row = attn_out + (q_start + qi) * D + offset;
                for (int d = 0; d < head_dim; d++) {
                    float acc = 0.0f;
                    for (int vi = 0; vi < T; vi++)
                        acc += scores_chunk[qi * T + vi] * proj_v[vi * D + offset + d];
                    out_row[d] += acc;
                }
            }
        }
    }

    // Output projection: each row attn_out[t] = Wo @ attn_out[t] + bo
    for (int t = 0; t < T; t++) {
        linear_i8(Wo, bo, so, attn_out + t*D, tmp_D, D, D);
        memcpy(attn_out + t*D, tmp_D, D * sizeof(float));
    }
}

// ── Transformer block (used for cross- and self-attention) ────────────────────
// Computes:
//   attn_out = MHA(q, k, v) + q          (residual on q)
//   x        = LayerNorm1(attn_out)
//   ffn_out  = FFN(x) + x
//   out      = LayerNorm2(ffn_out)
//
// For self-attention pass q==k==v.
// out may alias q (computed row-by-row, safe if caller uses separate buffers).
static void transformer_block(
        float* q,              // [T, D]  — also residual stream
        const float* kv,       // [T, D]  (== q for self-attn)
        int T, int D, int num_heads,
        // MHA weights
        const int8_t* Wq, const float* bq, float sq,
        const int8_t* Wk, const float* bk, float sk,
        const int8_t* Wv, const float* bv, float sv,
        const int8_t* Wo, const float* bo, float so,
        // LN1
        const float* ln1_w, const float* ln1_b,
        // FFN: fc0 [D*2, D], fc1 [D, D*2]
        const int8_t* Wf0, const float* bf0, float sf0,
        const int8_t* Wf1, const float* bf1, float sf1,
        // LN2
        const float* ln2_w, const float* ln2_b,
        // scratch (caller-provided)
        float* proj_q,         // [T × D]
        float* proj_k,         // [T × D]
        float* proj_v,         // [T × D]
        float* scores_chunk,   // [CHUNK × T]
        float* attn_buf,       // [T × D]
        float* tmp_D,          // [D]
        float* ffn_hidden,     // [D*2]
        float* row_buf)        // [D]   for LN output
{
    // 1. MHA
    chunked_mha(q, kv, kv, T, D, num_heads,
                Wq, bq, sq, Wk, bk, sk, Wv, bv, sv, Wo, bo, so,
                proj_q, proj_k, proj_v, scores_chunk, attn_buf, tmp_D);

    // 2. Residual + LN1  (row by row)
    for (int t = 0; t < T; t++) {
        float* qt = q + t*D;
        float* at = attn_buf + t*D;
        for (int d = 0; d < D; d++) row_buf[d] = qt[d] + at[d];
        layer_norm(row_buf, ln1_w, ln1_b, qt, D);  // write back into q
    }

    // 3. FFN + residual + LN2  (row by row)
    for (int t = 0; t < T; t++) {
        float* qt = q + t*D;
        // fc0: [D*2, D]
        linear_i8(Wf0, bf0, sf0, qt, ffn_hidden, D*2, D);
        relu_buf(ffn_hidden, D*2);
        // fc1: [D, D*2]
        linear_i8(Wf1, bf1, sf1, ffn_hidden, row_buf, D, D*2);
        // residual
        for (int d = 0; d < D; d++) row_buf[d] += qt[d];
        layer_norm(row_buf, ln2_w, ln2_b, qt, D);
    }
}

// ── Attention Pooling ─────────────────────────────────────────────────────────
// score = softmax(fc1(tanh(fc0(token))))  over T dimension
// output = sum_t(score[t] * token[t])
static void attention_pooling(
        const float* tokens,   // [T, D]
        int T, int D,
        const int8_t* Wp0, const float* bp0, float sp0,  // fc0: [2D, D]
        const int8_t* Wp1, const float* bp1, float sp1,  // fc1: [1, 2D]
        float* out,            // [D]
        float* h_buf,          // scratch [2D]
        float* scores)         // scratch [T]
{
    for (int t = 0; t < T; t++) {
        // fc0 -> tanh
        linear_i8(Wp0, bp0, sp0, tokens + t*D, h_buf, 2*D, D);
        for (int i = 0; i < 2*D; i++) h_buf[i] = tanhf_approx(h_buf[i]);
        // fc1 -> scalar score
        float s = 0.0f;
        for (int i = 0; i < 2*D; i++) s += (float)Wp1[i] * h_buf[i];
        scores[t] = s * sp1 + bp1[0];
    }
    softmax_inplace(scores, T);

    memset(out, 0, D * sizeof(float));
    for (int t = 0; t < T; t++)
        for (int d = 0; d < D; d++)
            out[d] += scores[t] * tokens[t*D + d];
}

// ── Top-level inference ───────────────────────────────────────────────────────
// All weight pointers come from the generated weights_flash.h.
// Caller is responsible for signal normalisation (zero-mean / unit-std per window)
// before passing red[]/ir[] if normalize_seq was True during training.
//
// Returns SpO2 in original units (de-normalised with y_mean, y_std from meta.h).

typedef struct {
    // Conv encoders (red)
    const int8_t *red_conv0_w, *red_conv1_w, *red_conv2_w;
    const float  *red_conv0_b, *red_conv1_b, *red_conv2_b;
    float         red_conv0_s,  red_conv1_s,  red_conv2_s;
    // Conv encoders (ir)
    const int8_t *ir_conv0_w, *ir_conv1_w, *ir_conv2_w;
    const float  *ir_conv0_b, *ir_conv1_b, *ir_conv2_b;
    float         ir_conv0_s,   ir_conv1_s,  ir_conv2_s;
    // SkinFiLM
    const int8_t *film_fc0_w, *film_fc1_w;
    const float  *film_fc0_b, *film_fc1_b;
    float         film_fc0_s,  film_fc1_s;
    // red_to_ir cross-attention
    const int8_t *r2i_Wq,*r2i_Wk,*r2i_Wv,*r2i_Wo,*r2i_ffn0_w,*r2i_ffn1_w;
    const float  *r2i_bq,*r2i_bk,*r2i_bv,*r2i_bo,*r2i_ffn0_b,*r2i_ffn1_b;
    float         r2i_sq,r2i_sk,r2i_sv,r2i_so,r2i_sf0,r2i_sf1;
    const float  *r2i_norm1_w,*r2i_norm1_b,*r2i_norm2_w,*r2i_norm2_b;
    // ir_to_red cross-attention
    const int8_t *i2r_Wq,*i2r_Wk,*i2r_Wv,*i2r_Wo,*i2r_ffn0_w,*i2r_ffn1_w;
    const float  *i2r_bq,*i2r_bk,*i2r_bv,*i2r_bo,*i2r_ffn0_b,*i2r_ffn1_b;
    float         i2r_sq,i2r_sk,i2r_sv,i2r_so,i2r_sf0,i2r_sf1;
    const float  *i2r_norm1_w,*i2r_norm1_b,*i2r_norm2_w,*i2r_norm2_b;
    // temporal self-attention (dim = 2D)
    const int8_t *ta_Wq,*ta_Wk,*ta_Wv,*ta_Wo,*ta_ffn0_w,*ta_ffn1_w;
    const float  *ta_bq,*ta_bk,*ta_bv,*ta_bo,*ta_ffn0_b,*ta_ffn1_b;
    float         ta_sq,ta_sk,ta_sv,ta_so,ta_sf0,ta_sf1;
    const float  *ta_norm1_w,*ta_norm1_b,*ta_norm2_w,*ta_norm2_b;
    // attention pooling
    const int8_t *pool_fc0_w, *pool_fc1_w;
    const float  *pool_fc0_b, *pool_fc1_b;
    float         pool_fc0_s,  pool_fc1_s;
    // regressor
    const int8_t *reg_fc0_w, *reg_fc1_w, *reg_fc2_w;
    const float  *reg_fc0_b, *reg_fc1_b, *reg_fc2_b;
    float         reg_fc0_s,  reg_fc1_s,  reg_fc2_s;
    // normalisation
    float y_mean, y_std;
} SpO2ModelWeights;

// Static scratch buffers — allocated once (in BSS, not stack).
// Sized for MODEL_SEQ_LEN=400, D=64.  Adjust if you retrain with smaller T.
#define _T   MODEL_SEQ_LEN
#define _TL  CONV_OUT_LEN          // T - 2
#define _D   MODEL_HIDDEN_DIM
#define _D2  MODEL_HIDDEN_DIM2
#define _CK  CHUNKED_ATTN_SIZE

static float _red_tok [_TL * _D];       // [T_out, D]    — red encoder output
static float _ir_tok  [_TL * _D];       // [T_out, D]    — ir encoder output
static float _fused   [_TL * _D2];      // [T_out, 2D]   — after concat

// Conv scratch (reused between red and ir encoders)
static float _conv_a  [_D  * _T];       // [D, T]  (D>=32 covers block1 output too)
static float _conv_b  [_D  * _T];       // [D, T]

// MHA scratch (sized for worst case: dim=2D, T rows)
static float _proj_q  [_TL * _D2];
static float _proj_k  [_TL * _D2];
static float _proj_v  [_TL * _D2];
static float _scores  [_CK * _T];       // chunked scores
static float _attn_buf[_TL * _D2];
static float _tmp_D2  [_D2];
static float _ffn_hid [_D2 * 2];        // FFN hidden (2×dim, worst case 2×2D)
static float _row_buf [_D2];

// Pooling scratch
static float _pool_h  [_D2 * 2];
static float _pool_s  [_TL];
static float _pooled  [_D2];

// Copy of film-modulated red tokens saved before cross-attention.
// Both r2i and i2r must attend to the same pre-cross-attended red tokens;
// without this copy, r2i overwrites _red_tok before i2r can use it as kv.
static float _red_tok_pre [_TL * _D];

// SkinFiLM outputs
static float _gamma_r [_D];
static float _beta_r  [_D];

// Regressor hidden
static float _reg_h0  [_D];
static float _reg_h1  [16];

float spo2_infer(const float* red, const float* ir, float skintone,
                 const SpO2ModelWeights* W)
{
    // ── 1. Encode red and IR ───────────────────────────────────────────────
    // Input must be [1, T] (single channel).  red/ir are already length T.
    conv_encoder(red, _T,
                 W->red_conv0_w, W->red_conv0_b, W->red_conv0_s,
                 W->red_conv1_w, W->red_conv1_b, W->red_conv1_s,
                 W->red_conv2_w, W->red_conv2_b, W->red_conv2_s,
                 _D, _conv_a, _conv_b, _red_tok);

    conv_encoder(ir, _T,
                 W->ir_conv0_w, W->ir_conv0_b, W->ir_conv0_s,
                 W->ir_conv1_w, W->ir_conv1_b, W->ir_conv1_s,
                 W->ir_conv2_w, W->ir_conv2_b, W->ir_conv2_s,
                 _D, _conv_a, _conv_b, _ir_tok);

    // ── 2. SkinFiLM → modulate red tokens ────────────────────────────────
    skin_film(skintone,
              W->film_fc0_w, W->film_fc0_b, W->film_fc0_s,
              W->film_fc1_w, W->film_fc1_b, W->film_fc1_s,
              _D, _gamma_r, _beta_r);

    film_modulate(_red_tok, _TL, _D, _gamma_r, _beta_r);

    // ── 3. Cross-attention: red queries IR, ir queries red ─────────────────
    // Save film-modulated red tokens before either cross-attention block runs.
    // transformer_block() writes its output back into its first argument (q),
    // so without this copy _red_tok would be overwritten by r2i before i2r
    // can use it as its kv — producing wrong results (same bug fixed in Python).
    memcpy(_red_tok_pre, _red_tok, _TL * _D * sizeof(float));

    // red_to_ir: q=red (film-modulated), kv=ir (original encoder output)
    // Result overwrites _red_tok with cross-attended red tokens.
    transformer_block(
        _red_tok, _ir_tok, _TL, _D, MODEL_NUM_HEADS,
        W->r2i_Wq, W->r2i_bq, W->r2i_sq,
        W->r2i_Wk, W->r2i_bk, W->r2i_sk,
        W->r2i_Wv, W->r2i_bv, W->r2i_sv,
        W->r2i_Wo, W->r2i_bo, W->r2i_so,
        W->r2i_norm1_w, W->r2i_norm1_b,
        W->r2i_ffn0_w, W->r2i_ffn0_b, W->r2i_sf0,
        W->r2i_ffn1_w, W->r2i_ffn1_b, W->r2i_sf1,
        W->r2i_norm2_w, W->r2i_norm2_b,
        _proj_q, _proj_k, _proj_v, _scores, _attn_buf, _tmp_D2, _ffn_hid, _row_buf);

    // ir_to_red: q=ir (original), kv=red (film-modulated, PRE-cross-attn copy)
    // Must use _red_tok_pre not _red_tok — the latter was just overwritten above.
    transformer_block(
        _ir_tok, _red_tok_pre, _TL, _D, MODEL_NUM_HEADS,
        W->i2r_Wq, W->i2r_bq, W->i2r_sq,
        W->i2r_Wk, W->i2r_bk, W->i2r_sk,
        W->i2r_Wv, W->i2r_bv, W->i2r_sv,
        W->i2r_Wo, W->i2r_bo, W->i2r_so,
        W->i2r_norm1_w, W->i2r_norm1_b,
        W->i2r_ffn0_w, W->i2r_ffn0_b, W->i2r_sf0,
        W->i2r_ffn1_w, W->i2r_ffn1_b, W->i2r_sf1,
        W->i2r_norm2_w, W->i2r_norm2_b,
        _proj_q, _proj_k, _proj_v, _scores, _attn_buf, _tmp_D2, _ffn_hid, _row_buf);

    // ── 4. Concatenate -> fused [T, 2D] ───────────────────────────────────
    for (int t = 0; t < _TL; t++) {
        memcpy(_fused + t*_D2,       _red_tok + t*_D, _D * sizeof(float));
        memcpy(_fused + t*_D2 + _D,  _ir_tok  + t*_D, _D * sizeof(float));
    }

    // ── 5. Temporal self-attention (dim = 2D) ─────────────────────────────
    transformer_block(
        _fused, _fused, _TL, _D2, MODEL_NUM_HEADS,
        W->ta_Wq, W->ta_bq, W->ta_sq,
        W->ta_Wk, W->ta_bk, W->ta_sk,
        W->ta_Wv, W->ta_bv, W->ta_sv,
        W->ta_Wo, W->ta_bo, W->ta_so,
        W->ta_norm1_w, W->ta_norm1_b,
        W->ta_ffn0_w, W->ta_ffn0_b, W->ta_sf0,
        W->ta_ffn1_w, W->ta_ffn1_b, W->ta_sf1,
        W->ta_norm2_w, W->ta_norm2_b,
        _proj_q, _proj_k, _proj_v, _scores, _attn_buf, _tmp_D2, _ffn_hid, _row_buf);

    // ── 6. Attention pooling -> [2D] ──────────────────────────────────────
    attention_pooling(_fused, _TL, _D2,
                      W->pool_fc0_w, W->pool_fc0_b, W->pool_fc0_s,
                      W->pool_fc1_w, W->pool_fc1_b, W->pool_fc1_s,
                      _pooled, _pool_h, _pool_s);

    // ── 7. Regressor MLP ──────────────────────────────────────────────────
    // fc0: [D, 2D]  ReLU
    linear_i8(W->reg_fc0_w, W->reg_fc0_b, W->reg_fc0_s, _pooled, _reg_h0, _D, _D2);
    relu_buf(_reg_h0, _D);
    // fc1: [16, D]  ReLU
    linear_i8(W->reg_fc1_w, W->reg_fc1_b, W->reg_fc1_s, _reg_h0, _reg_h1, 16, _D);
    relu_buf(_reg_h1, 16);
    // fc2: [1, 16]
    float y_norm = 0.0f;
    for (int i = 0; i < 16; i++) y_norm += (float)W->reg_fc2_w[i] * _reg_h1[i];
    y_norm = y_norm * W->reg_fc2_s + W->reg_fc2_b[0];

    // ── 8. De-normalise ───────────────────────────────────────────────────
    return y_norm * W->y_std + W->y_mean;
}

#ifdef __cplusplus
}
#endif